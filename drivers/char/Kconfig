## drivers/char/Kconfig
```kconfig
#
# Character device configuration
#

menu "Character devices"

config SKBD
	tristate "serial character keyboard"
	help
	  Say Y here if you want to use serial character keyboard.

	  If unsure, say N.

	  To compile this driver as a module, choose M here: the
	  module will be called skbd.

endmenu
```
